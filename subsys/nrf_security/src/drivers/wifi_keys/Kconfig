## subsys/nrf_security/src/drivers/wifi_keys/Kconfig
```kconfig
#
# Copyright (c) 2026 Nordic Semiconductor
#
# SPDX-License-Identifier: LicenseRef-Nordic-5-Clause
#

config HAS_HW_NRF_WIFI_KEYS
	def_bool SOC_SERIES_NRF71X

config WIFI_KEYS_KMU_HW_PRESENT
	def_bool SOC_SERIES_NRF71X

# Configure WIFI_KEYS_LOG_LEVEL
module = WIFI_KEYS
module-str = WIFI_KEYS
source "$(ZEPHYR_BASE)/subsys/logging/Kconfig.template.log_config"
```
